/* sgp4_host_test.c  -  Host test driver for firmware/soop/sgp4.{c,h}.
 *
 * Reads the vendored iridium-next.tle, propagates every satellite at offsets
 * 0, +1, -1, +3, -3 days, and compares against a reference position/velocity
 * table generated by the Python sgp4 library.  Exits 0 on pass, 1 on fail.
 *
 * Reference table is provided on stdin in the form:
 *   <norad_id> <offset_days> <rx> <ry> <rz> <vx> <vy> <vz>
 * (generated by tools/check_soop_sgp4.py --dump-ref)
 *
 * Tolerances (from sgp4.h):
 *   position : 1000 m = 1 km   (5 Hz Doppler + headroom)
 *   velocity :    1.5 m/s
 */

#include "sgp4.h"
#include <math.h>
#include <stdio.h>
#include <string.h>
#include <stdlib.h>

static double norm3(const double v[3])
{
    return sqrt(v[0]*v[0] + v[1]*v[1] + v[2]*v[2]);
}

int main(int argc, char *argv[])
{
    if (argc < 3) {
        fprintf(stderr, "usage: sgp4_host_test <tle_file> <ref_file>\n");
        return 2;
    }

    /* Read TLE file */
    FILE *ftl = fopen(argv[1], "r");
    if (!ftl) { perror(argv[1]); return 2; }

    /* Build satellite table: name, line1, line2 */
    #define MAX_SATS 128
    char names[MAX_SATS][32];
    char line1s[MAX_SATS][80];
    char line2s[MAX_SATS][80];
    int nsats = 0;
    char buf[128];
    while (fgets(buf, sizeof(buf), ftl) && nsats < MAX_SATS) {
        if (buf[0] == '#' || buf[0] == '\n') continue;
        /* Name line */
        buf[strcspn(buf, "\r\n")] = 0;
        strncpy(names[nsats], buf, 31);
        /* Line 1 */
        if (!fgets(line1s[nsats], 80, ftl)) break;
        line1s[nsats][strcspn(line1s[nsats], "\r\n")] = 0;
        /* Line 2 */
        if (!fgets(line2s[nsats], 80, ftl)) break;
        line2s[nsats][strcspn(line2s[nsats], "\r\n")] = 0;
        nsats++;
    }
    fclose(ftl);
    printf("Loaded %d satellites from %s\n", nsats, argv[1]);

    /* Read reference file */
    FILE *fref = fopen(argv[2], "r");
    if (!fref) { perror(argv[2]); return 2; }

    const double pos_tol_km = 1.0;    /* 1 km */
    const double vel_tol_km_s = 0.0015; /* 1.5 m/s -> km/s */

    int pass = 0, fail = 0, skip = 0;
    int norad; double offset_days;
    double rx, ry, rz, vx, vy, vz;

    while (fscanf(fref, "%d %lf %lf %lf %lf %lf %lf %lf",
                  &norad, &offset_days, &rx, &ry, &rz, &vx, &vy, &vz) == 8) {

        /* Find the matching satellite by norad ID (from line 1, col 3-7) */
        sgp4_tle_t tle;
        sgp4_t sat;
        int found = 0;
        for (int i = 0; i < nsats; i++) {
            int id;
            sscanf(line1s[i] + 2, "%5d", &id);
            if (id == norad) {
                if (sgp4_parse_tle(line1s[i], line2s[i], &tle) != SGP4_OK) {
                    fprintf(stderr, "SKIP: parse error NORAD %d\n", norad);
                    skip++;
                    found = -1;
                    break;
                }
                int rc = sgp4_init(&tle, &sat);
                if (rc != SGP4_OK) {
                    fprintf(stderr, "SKIP: init error %d for NORAD %d\n", rc, norad);
                    skip++;
                    found = -1;
                    break;
                }
                found = 1;
                break;
            }
        }
        if (found != 1) continue;

        /* Propagate */
        double tsince = offset_days * 1440.0;  /* days -> minutes */
        double r_c[3], v_c[3];
        int rc = sgp4_propagate(&sat, tsince, r_c, v_c);
        if (rc != SGP4_OK) {
            fprintf(stderr, "FAIL: propagate error %d NORAD %d offset %+g d\n",
                    rc, norad, offset_days);
            fail++;
            continue;
        }

        /* Compare (reference in km, km/s; ours in km, km/s) */
        double dr[3] = { r_c[0]-rx, r_c[1]-ry, r_c[2]-rz };
        double dv[3] = { v_c[0]-vx, v_c[1]-vy, v_c[2]-vz };
        double pos_err = norm3(dr);
        double vel_err = norm3(dv);

        if (pos_err > pos_tol_km || vel_err > vel_tol_km_s) {
            fprintf(stderr,
                    "FAIL NORAD %5d offset %+g d: pos_err %.3f km vel_err %.4f km/s\n",
                    norad, offset_days, pos_err, vel_err);
            fail++;
        } else {
            pass++;
        }
    }
    fclose(fref);

    printf("Results: %d pass  %d fail  %d skip\n", pass, fail, skip);
    if (fail > 0) {
        printf("SGP4 HOST TEST FAILED\n");
        return 1;
    }
    printf("SGP4 HOST TEST OK - %d checks against Python reference (tol: %.0f m, %.0f mm/s)\n",
           pass, pos_tol_km * 1000, vel_tol_km_s * 1e6);
    return 0;
}
